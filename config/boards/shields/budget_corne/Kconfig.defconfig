## config/boards/shields/budget_corne/Kconfig.defconfig
```kconfig
if SHIELD_BUDGET_CORNE_LEFT

config ZMK_KEYBOARD_NAME
	default "Corne"

config ZMK_SPLIT_ROLE_CENTRAL
	default y

endif

if SHIELD_BUDGET_CORNE_LEFT || SHIELD_BUDGET_CORNE_RIGHT

config ZMK_SPLIT
	default y

if ZMK_DISPLAY

config I2C
	default y

config SSD1306
	default y

endif # ZMK_DISPLAY

endif
```

## config/boards/shields/budget_corne/Kconfig.shield
```kconfig
config SHIELD_BUDGET_CORNE_LEFT
	def_bool $(shields_list_contains,budget_corne_left)

config SHIELD_BUDGET_CORNE_RIGHT
	def_bool $(shields_list_contains,budget_corne_right)
```

## config/west.yml
```yaml
manifest:
  remotes:
    - name: zmkfirmware
      url-base: https://github.com/zmkfirmware
  projects:
    - name: zmk
      remote: zmkfirmware
      revision: v0.3.0
      import: true
  self:
    path: config
```

## modules/zmk-corne-display/Kconfig
```kconfig
menuconfig CORNE_DISPLAY
    bool "Corne left-half OLED status screen"
    depends on ZMK_DISPLAY && ZMK_SPLIT_ROLE_CENTRAL
    select ZMK_DISPLAY_STATUS_SCREEN_CUSTOM
    help
      Custom 128x32 status screen for Corne v3 OLED on the central (left) half:
      active layer, battery, host connection, split half link.

if CORNE_DISPLAY

config ZMK_WIDGET_SPLIT_HALF_STATUS
    bool "Widget: split peripheral link (central)"
    default y
    select LV_USE_LABEL

endif
```
